/*
  Scrolling Name Sign — Parts Lab
  Boards: Arduino Uno / Nano / Mega / Leonardo
  Library: LedControl
  Wiring: MAX7219 4-in-1 (32x8): VCC -> 5V, GND -> GND, DIN -> 12, CS -> 10, CLK -> 11
*/
#include <LedControl.h>
#include <avr/pgmspace.h>

const char MESSAGE[] = "  HELLO LAB MEMBER 001!  ";   // CHANGE ME (A-Z, 0-9, ! ? . , - : ' ")
const int DEVICES = 4;
const int INTENSITY = 2;        // 0..15 (keep low on USB power)
const int SPEED_MS = 45;        // lower = faster scrolling
// 4-in-1 modules differ. If text is mirrored, upside down or jumbled, flip these one at a time:
const bool REVERSE_DEVICES = true;
const bool ROTATE = false;
const bool FLIP = false;

LedControl lc(12, 11, 10, DEVICES);   // DIN, CLK, CS

// Classic 5x7 font for ASCII 32 (space) .. 90 (Z). Each byte is one column, bit 0 = top.
const byte FONT[][5] PROGMEM = {
  {0x00,0x00,0x00,0x00,0x00},{0x00,0x00,0x5F,0x00,0x00},{0x00,0x07,0x00,0x07,0x00},{0x14,0x7F,0x14,0x7F,0x14},
  {0x24,0x2A,0x7F,0x2A,0x12},{0x23,0x13,0x08,0x64,0x62},{0x36,0x49,0x55,0x22,0x50},{0x00,0x05,0x03,0x00,0x00},
  {0x00,0x1C,0x22,0x41,0x00},{0x00,0x41,0x22,0x1C,0x00},{0x08,0x2A,0x1C,0x2A,0x08},{0x08,0x08,0x3E,0x08,0x08},
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  {0x63,0x14,0x08,0x14,0x63},{0x07,0x08,0x70,0x08,0x07},{0x61,0x51,0x49,0x45,0x43}
};

byte reverseBits(byte b) {
  byte r = 0;
  for (int i = 0; i < 8; i++) if (b & (1 << i)) r |= 1 << (7 - i);
  return r;
}

// One column of the message (each letter = 5 columns + 1 blank)
byte messageColumn(int index) {
  int charIndex = index / 6;
  int col = index % 6;
  char c = MESSAGE[charIndex];
  if (c >= 'a' && c <= 'z') c -= 32;          // lowercase -> uppercase
  if (c < 32 || c > 90 || col == 5) return 0;
  return pgm_read_byte(&FONT[c - 32][col]);
}

void drawColumn(int x, byte bits) {           // x = 0 (left) .. 31 (right)
  int dev = x / 8;
  int col = x % 8;
  if (REVERSE_DEVICES) dev = DEVICES - 1 - dev;
  if (FLIP) col = 7 - col;
  if (ROTATE) lc.setRow(dev, col, bits);
  else lc.setColumn(dev, col, reverseBits(bits));
}

void setup() {
  for (int d = 0; d < DEVICES; d++) {
    lc.shutdown(d, false);
    lc.setIntensity(d, INTENSITY);
    lc.clearDisplay(d);
  }
}

void loop() {
  int totalColumns = strlen(MESSAGE) * 6;
  for (int offset = 0; offset < totalColumns; offset++) {
    for (int x = 0; x < DEVICES * 8; x++) {
      drawColumn(x, messageColumn((offset + x) % totalColumns));
    }
    delay(SPEED_MS);
  }
}
